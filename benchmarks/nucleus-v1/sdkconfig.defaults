## main/Kconfig.projbuild
```kconfig
menu "Cirvane development options"

config CIRVANE_RELEASE_SEQUENCE
    int "Authenticated OTA release sequence"
    range 0 2147483647
    default 0
    help
        Monotonic anti-replay sequence compiled into this image. Development
        builds use zero. Each official release must increment the value.

config CIRVANE_HIL_DIAGNOSTICS
    bool "Enable destructive hardware-in-the-loop diagnostics"
    default n
    help
        Exposes commands that deliberately corrupt an inactive OTA image or
        one transactional configuration slot to prove rejection and recovery.
        Enable only on development boards; production builds must leave this
        disabled.

config CIRVANE_MATCHED_EVAL
    bool "Run the rebooting matched recovery evaluation at boot"
    depends on CIRVANE_HIL_DIAGNOSTICS
    default n
    help
        Runs the fixed 33-sample class-1 recovery campaign across repeated
        software resets before the shell starts. Enable only in the dedicated
        matched-evaluation profile; generic HIL builds must leave this off.

endmenu
```
